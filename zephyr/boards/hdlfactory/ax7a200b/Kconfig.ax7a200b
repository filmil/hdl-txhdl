## zephyr/boards/hdlfactory/ax7a200b/Kconfig.ax7a200b
```kconfig
# SPDX-License-Identifier: Apache-2.0

config BOARD_AX7A200B
	select SOC_VRETENO
```

## zephyr/boards/hdlfactory/ax7a200b/ax7a200b_defconfig
```kconfig
CONFIG_XIP=n
CONFIG_SERIAL=y
CONFIG_UART_SIFIVE_PORT_0=y
CONFIG_CONSOLE=y
CONFIG_UART_CONSOLE=y
CONFIG_RISCV_MACHINE_TIMER=y
CONFIG_PLIC=y
```

## zephyr/boards/hdlfactory/ax7a200b/board.yml
```yaml
# SPDX-License-Identifier: Apache-2.0
board:
  name: ax7a200b
  vendor: hdlfactory
  socs:
    - name: vreteno
```

## zephyr/drivers/Kconfig
```kconfig
# SPDX-License-Identifier: Apache-2.0

rsource "entropy/Kconfig.vreteno"
rsource "ethernet/Kconfig.vreteno"
rsource "serial/Kconfig.vreteno"
```

## zephyr/drivers/entropy/Kconfig.vreteno
```kconfig
# SPDX-License-Identifier: Apache-2.0

config ENTROPY_VRETENO
	bool "Vreteno entropy source"
	default y
	depends on DT_HAS_HDLFACTORY_VRETENO_TRNG_ENABLED
	depends on ENTROPY_GENERATOR
	select ENTROPY_HAS_DRIVER
	help
	  The entropy source of the Vreteno machine: ring oscillators
	  sampled, folded, debiased and buffered by the hardware, read a
	  word at a time, and conditioned here with SHA-256, 32 words to
	  each 32 bytes (issue 780). `ENTROPY_HAS_DRIVER` is what makes the
	  random subsystem take its numbers from a device rather than from
	  the test generator, which is a counter.

	  The SHA-256 is Mbed TLS's, which the SoC turns on by default
	  with this driver. It is not selected here, since Mbed TLS can
	  select ENTROPY_GENERATOR, which this depends on, and Kconfig
	  calls that a loop. The driver does not compile without it.
```

## zephyr/drivers/ethernet/Kconfig.vreteno
```kconfig
# SPDX-License-Identifier: Apache-2.0

config ETH_VRETENO
	bool "Vreteno Ethernet port"
	default y
	depends on DT_HAS_HDLFACTORY_VRETENO_ETH_ENABLED
	depends on NETWORKING
	select ETH_DRIVER
	help
	  The Ethernet port of the Vreteno machine: two slots each way
	  with a whole frame in each, and ten registers in front of
	  them.

	  `ETH_DRIVER` is what the networking subsystem counts, and a
	  driver that does not select it is a driver the stack never
	  looks for. The serial port made the same mistake with
	  `SERIAL_HAS_DRIVER`, where the symptom was a console that was
	  silently not a console; here it would be an interface that
	  never appears.

	  The dependency on `NETWORKING` is not decoration. `ETH_DRIVER`
	  itself depends on it, so a build without a network stack, which
	  is every build of `hello_world`, refuses the configuration
	  outright rather than quietly building a driver nothing can use.
	  That is what the hermetic build of issue 390 found the first
	  time it compiled this file.

	  Frames are copied into the slots rather than handed over,
	  because Zephyr's `net_pkt` is a chain of fragments and both
	  `net_pkt_read` and `net_pkt_write` linearise. That is why the
	  hardware needs no scatter-gather.
```

## zephyr/drivers/serial/Kconfig.vreteno
```kconfig
# SPDX-License-Identifier: Apache-2.0

config UART_VRETENO
	bool "Vreteno serial port"
	default y
	depends on DT_HAS_HDLFACTORY_VRETENO_UART_ENABLED
	select SERIAL_HAS_DRIVER
	help
	  The serial port of the Vreteno machine: one data register, one
	  status register and one receive register. Polled only, since
	  the hardware raises an interrupt for a byte received and none
	  for a byte sent, so there is nothing for an interrupt-driven
	  transmit path to wait on.

	  `SERIAL_HAS_DRIVER` is what `UART_CONSOLE` depends on. A
	  driver that does not select it builds, and the console then
	  silently is not a console: the symbol never becomes visible
	  and the board defconfig's request for it is dropped without a
	  word.
```

## zephyr/soc/hdlfactory/vreteno/Kconfig.soc
```kconfig
# SPDX-License-Identifier: Apache-2.0

config SOC_VRETENO
	bool
	select SOC_FAMILY_HDLFACTORY
	help
	  The Vreteno RV32IMC core with its bus, its timer and its
	  interrupt controller.

	  What the core is, rather than how it is configured, is said
	  next door in `Kconfig`: the hardware model wants this file to
	  name the SoC and its family and little else.

config SOC
	default "vreteno" if SOC_VRETENO
```
