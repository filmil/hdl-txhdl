## CMakeLists.txt
```
# SPDX-License-Identifier: Apache-2.0
#
# A Zephyr program drawing through EGL and GL ES 1.1 on Razboj (issue
# 996): the GL library, EGL and the board's machine come from Bazel as
# one static library built for the core, with the C that writes the
# entry points the library does not implement, and Khronos's headers.
cmake_minimum_required(VERSION 3.20.0)
find_package(Zephyr REQUIRED HINTS $ENV{ZEPHYR_BASE})
project(gles)

target_sources(app PRIVATE src/main.c ${TXHDL_SOURCES})
target_include_directories(app PRIVATE ${TXHDL_INCLUDES})
target_compile_definitions(app PRIVATE EGL_NO_PLATFORM_SPECIFIC_TYPES)
target_link_libraries(app PRIVATE ${TXHDL_LIBS})
```

## prj.conf
```kconfig
# SPDX-License-Identifier: Apache-2.0
# The program says what it does on the console, and needs nothing else.
CONFIG_PRINTK=y
# GL's matrices and a triangle's setup are on the stack, which is more
# than Zephyr's kilobyte for main.
CONFIG_MAIN_STACK_SIZE=16384
# Code in the DDR3 and the RAM in the core's own memory, which the
# board overlay names (issue 1287).
CONFIG_XIP=y
```

## boards/ax7a200b.overlay
```dts
/* SPDX-License-Identifier: Apache-2.0 */
/*
 * The program's RAM, its stacks, the GL and EGL state and its data
 * among it, is the core's own data memory: the 64 KiB at 0x1_0000 on
 * the core's port (#1275), which a load reaches in a cycle or two where
 * the DDR3 takes tens even behind the data cache (issue 1287). Code
 * stays in the DDR3, since a fetch from the core's memory faults.
 * Nothing Razboj reads is here: the framebuffers, the display list, the
 * textures and the buffers are at fixed addresses in the DDR3, in
 * gles/vreteno/lib.rs. Linked as execute-in-place, as fastboot is: the
 * image is code in the DDR3, and its data is copied to the core's
 * memory as it starts.
 */
/ {
	chosen {
		zephyr,sram = &lram;
		zephyr,flash = &ddr;
	};

	soc {
		lram: memory@10000 {
			compatible = "mmio-sram";
			reg = <0x00010000 DT_SIZE_K(64)>;
		};
	};
};
```

## src/main.c
```c
/* SPDX-License-Identifier: Apache-2.0 */
/*
 * A Zephyr program on Vreteno drawing through EGL and GL ES 1.1, which
 * Razboj rasterises (issue 996): a fan of six triangles, lit, turning a
 * little each frame, double buffered and swapped on the vertical
 * blanking, so that no frame is shown half drawn.
 *
 * It says `gles egl 1.4` once EGL is up, then every sixty frames the
 * frame count and the cycles the last frame took, from the clear to
 * the end of the swap.
 */
#include <EGL/egl.h>
#include <GLES/gl.h>
#include <zephyr/kernel.h>
#include <zephyr/sys/printk.h>

/* Not EGL: the board's machine for EGL, before eglInitialize. */
extern void egl_vreteno_install(void);

#define ONE 65536

/* The fan: its centre and seven points round it, the last the first. */
static const GLfixed fan[8][3] = {
    {0, 0, ONE / 4},
    {ONE / 2, 0, 0},
    {ONE / 4, 7 * ONE / 16, 0},
    {-ONE / 4, 7 * ONE / 16, 0},
    {-ONE / 2, 0, 0},
    {-ONE / 4, -7 * ONE / 16, 0},
    {ONE / 4, -7 * ONE / 16, 0},
    {ONE / 2, 0, 0},
};
/* A normal at each, leaning out from the centre. */
static const GLbyte normals[8][3] = {
    {0, 0, 127},  {90, 0, 90},  {45, 78, 90},  {-45, 78, 90},
    {-90, 0, 90}, {-45, -78, 90}, {45, -78, 90}, {90, 0, 90},
};

static uint32_t cycles(void) {
  uint32_t c;
  __asm__ volatile("csrr %0, mcycle" : "=r"(c));
  return c;
}

int main(void) {
  egl_vreteno_install();
  EGLDisplay dpy = eglGetDisplay(EGL_DEFAULT_DISPLAY);
  EGLint major = 0, minor = 0;
  if (!eglInitialize(dpy, &major, &minor)) {
    printk("gles egl failed %x\n", eglGetError());
    return 0;
  }
  static const EGLint want[] = {EGL_RED_SIZE, 8, EGL_GREEN_SIZE, 8,
                                EGL_BLUE_SIZE, 8, EGL_SURFACE_TYPE,
                                EGL_WINDOW_BIT, EGL_NONE};
  EGLConfig config;
  EGLint n = 0;
  eglChooseConfig(dpy, want, &config, 1, &n);
  EGLSurface surface = eglCreateWindowSurface(dpy, config, 0, 0);
  static const EGLint es1[] = {EGL_CONTEXT_CLIENT_VERSION, 1, EGL_NONE};
  EGLContext ctx = eglCreateContext(dpy, config, EGL_NO_CONTEXT, es1);
  if (n != 1 || surface == EGL_NO_SURFACE || ctx == EGL_NO_CONTEXT ||
      !eglMakeCurrent(dpy, surface, surface, ctx)) {
    printk("gles egl setup failed %x\n", eglGetError());
    return 0;
  }
  printk("gles egl %d.%d\n", major, minor);

  /* A projection whose window is twice as wide as it is high, less a
   * quarter, as 640 by 480 is, and a light at the eye. */
  glMatrixMode(GL_PROJECTION);
  glLoadIdentity();
  glFrustumx(-ONE / 2, ONE / 2, -3 * ONE / 8, 3 * ONE / 8, ONE, 8 * ONE);
  glMatrixMode(GL_MODELVIEW);
  glLoadIdentity();
  static const GLfixed light[4] = {0, 0, ONE, 0};
  glLightxv(GL_LIGHT0, GL_POSITION, light);
  glEnable(GL_LIGHTING);
  glEnable(GL_LIGHT0);
  glEnable(GL_NORMALIZE);
  static const GLfixed gold[4] = {ONE, 3 * ONE / 4, ONE / 4, ONE};
  glMaterialxv(GL_FRONT_AND_BACK, GL_AMBIENT_AND_DIFFUSE, gold);
  glEnableClientState(GL_VERTEX_ARRAY);
  glEnableClientState(GL_NORMAL_ARRAY);
  glVertexPointer(3, GL_FIXED, 0, fan);
  glNormalPointer(GL_BYTE, 0, normals);
  glClearColorx(0, 0, ONE / 8, ONE);

  for (uint32_t frame = 0;; frame++) {
    uint32_t start = cycles();
    glClear(GL_COLOR_BUFFER_BIT);
    glPushMatrix();
    glTranslatex(0, 0, -3 * ONE);
    glRotatex((GLfixed)(frame % 360) * ONE, ONE / 3, ONE, 0);
    glDrawArrays(GL_TRIANGLE_FAN, 0, 8);
    glPopMatrix();
    eglSwapBuffers(dpy, surface);
    uint32_t took = cycles() - start;
    if (frame % 60 == 0) {
      printk("gles frame %u cycles %u\n", frame, took);
    }
  }
  return 0;
}
```
