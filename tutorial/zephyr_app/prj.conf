## CMakeLists.txt
```
# SPDX-License-Identifier: Apache-2.0
#
# A Zephyr application in a package of its own, outside the port's
# module, as a repository that depends on TxHDL writes one (issue 1772).
cmake_minimum_required(VERSION 3.20.0)
find_package(Zephyr REQUIRED HINTS $ENV{ZEPHYR_BASE})
project(zephyr_app)

target_sources(app PRIVATE src/main.c)
```

## prj.conf
```kconfig
# SPDX-License-Identifier: Apache-2.0
#
# The console, and the network stack with TCP, which is what an
# application outside the port most often wants the port for; the
# rest as the port's own net.conf has it.
CONFIG_PRINTK=y
CONFIG_NETWORKING=y
CONFIG_NET_L2_ETHERNET=y
CONFIG_NET_IPV4=y
CONFIG_NET_IPV6=n
CONFIG_NET_TCP=y
CONFIG_NET_SOCKETS=y
CONFIG_ENTROPY_GENERATOR=y
CONFIG_MBEDTLS=y
```

## src/main.c
```c
// SPDX-License-Identifier: Apache-2.0
//
// The smallest application from a package of its own: it says where it
// was built from, and opens a TCP socket, so that the image links the
// stack its prj.conf asked for.
#include <zephyr/kernel.h>
#include <zephyr/net/socket.h>

int main(void)
{
	printk("zephyr_app: built from a package of its own\n");
	int s = zsock_socket(AF_INET, SOCK_STREAM, IPPROTO_TCP);
	printk("zephyr_app: TCP socket %s\n", s >= 0 ? "open" : "refused");
	return 0;
}
```
